## config/boards/shields/klink_kbd/Kconfig.defconfig
```kconfig
# Copyright (c) 2020 The ZMK Contributors
# SPDX-License-Identifier: MIT

# all use the same settings. remove #if

config ZMK_KEYBOARD_NAME
    default "tofu65_ble_v3"

config LED
    default n
```

## config/boards/shields/klink_kbd/Kconfig.shield
```kconfig
# Copyright (c) 2020 The ZMK Contributors
# SPDX-License-Identifier: MIT

config SHIELD_TOFU65_V3Z_ANSI
    def_bool $(shields_list_contains,tofu65_v3z_ansi)
    select SPI

config SHIELD_TOFU65_V3Z_ISO
    def_bool $(shields_list_contains,tofu65_v3z_iso)
    select SPI
```
